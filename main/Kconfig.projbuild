## main/Kconfig.projbuild
```kconfig
menu "Example Configuration"

    orsource "$IDF_PATH/examples/common_components/env_caps/$IDF_TARGET/Kconfig.env_caps"

    # This is for the I2C configuration

    config I2C_MASTER_SCL
        int "SCL GPIO Num"
        range ENV_GPIO_RANGE_MIN ENV_GPIO_OUT_RANGE_MAX
        default 4
        help
            GPIO number for I2C Master clock line.

    config I2C_MASTER_SDA
        int "SDA GPIO Num"
        range ENV_GPIO_RANGE_MIN ENV_GPIO_OUT_RANGE_MAX
        default 5
        help
            GPIO number for I2C Master data line.

    config I2C_MASTER_FREQUENCY
        int "Master Frequency"
        default 400000
        help
            I2C Speed of Master device.
            
            
    # the following are for the WiFi configuration        
    config ESP_WIFI_SSID
        string "WiFi SSID"
        default "myssid"
        help
            SSID (network name) for the example to connect to.

    config ESP_WIFI_PASSWORD
        string "WiFi Password"
        default "mypassword"
        help
            WiFi password (WPA or WPA2) for the example to use.

    choice ESP_WIFI_SAE_MODE
        prompt "WPA3 SAE mode selection"
        default ESP_STATION_EXAMPLE_WPA3_SAE_PWE_BOTH
        help
            Select mode for SAE as Hunt and Peck, H2E or both.
        config ESP_STATION_EXAMPLE_WPA3_SAE_PWE_HUNT_AND_PECK
            bool "HUNT AND PECK"
        config ESP_STATION_EXAMPLE_WPA3_SAE_PWE_HASH_TO_ELEMENT
            bool "H2E"
            depends on ESP_WIFI_ENABLE_SAE_H2E
        config ESP_STATION_EXAMPLE_WPA3_SAE_PWE_BOTH
            bool "BOTH"
            depends on ESP_WIFI_ENABLE_SAE_H2E
    endchoice

    config ESP_WIFI_PW_ID
        string "PASSWORD IDENTIFIER"
        depends on  ESP_STATION_EXAMPLE_WPA3_SAE_PWE_HASH_TO_ELEMENT|| ESP_STATION_EXAMPLE_WPA3_SAE_PWE_BOTH
        default ""
        help
            password identifier for SAE H2E

    config ESP_MAXIMUM_RETRY
        int "Maximum retry"
        default 5
        help
            Set the Maximum retry to avoid station reconnecting to the AP unlimited when the AP is really inexistent.

    choice ESP_WIFI_SCAN_AUTH_MODE_THRESHOLD
        prompt "WiFi Scan auth mode threshold"
        default ESP_WIFI_AUTH_WPA2_PSK
        help
            The weakest authmode to accept in the scan mode.
            This value defaults to ESP_WIFI_AUTH_WPA2_PSK in case password is present and ESP_WIFI_AUTH_OPEN is used.
            Please select ESP_WIFI_AUTH_WEP/ESP_WIFI_AUTH_WPA_PSK in case AP is operating in WEP/WPA mode.

        config ESP_WIFI_AUTH_OPEN
            bool "OPEN"
        config ESP_WIFI_AUTH_WEP
            bool "WEP"
        config ESP_WIFI_AUTH_WPA_PSK
            bool "WPA PSK"
        config ESP_WIFI_AUTH_WPA2_PSK
            bool "WPA2 PSK"
        config ESP_WIFI_AUTH_WPA_WPA2_PSK
            bool "WPA/WPA2 PSK"
        config ESP_WIFI_AUTH_WPA3_PSK
            bool "WPA3 PSK"
        config ESP_WIFI_AUTH_WPA2_WPA3_PSK
            bool "WPA2/WPA3 PSK"
        config ESP_WIFI_AUTH_WAPI_PSK
            bool "WAPI PSK"
    endchoice

endmenu
menu "BMX280 Options"
    choice I2C_DRIVER_SETTING
        prompt "I2C driver setting"
        help
            Select I2C Driver: I2C Legacy Driver: I2C.h , I2C Master Driver i2c_master.h for ESP-IDF >= 5.3 AND Set I2C Clock Speed.
        default USE_I2C_LEGACY_DRIVER
        config USE_I2C_LEGACY_DRIVER
            bool "I2C Legacy Driver (I2C.h)"
            help
                Use I2C Legacy Driver (I2C.h).
        config USE_I2C_MASTER_DRIVER
            bool "I2C Master Driver (i2c_master.h)"
            help
                Use I2C Master Driver (i2c_master.h) for ESP-IDF >= 5.3.
    endchoice
    
    config BMX280_I2C_CLK_SPEED_HZ
        int "I2C Clock Speed (Hz)"
        default 100000
        range 1000 400000
        help
            Set the I2C clock speed in Hz. Only applies to the new I2C Master driver.
    
    choice BMX280_EXPECT_DEVICE
        prompt "Installed Sensor Model"
        help
            Set to the model of the sensor you are using (if you know it).
        default BMX280_EXPECT_DETECT
        config BMX280_EXPECT_DETECT
            bool "Auto"
        config BMX280_EXPECT_BME280
            bool "BME280"
        config BMX280_EXPECT_BMP280
            bool "BMP280"
    endchoice

    choice BMX280_ADDRESS
        prompt "I2C Slave Address"
        help
            Set the slave address of the sensor if you know it. The driver can
            automatically detect it if you don't know.
        default BMX280_ADDRESS_DETECT
        config BMX280_ADDRESS_DETECT
            bool "Auto"
        config BMX280_ADDRESS_LO
            bool "0x76 (SDO LOW)"
        config BMX280_ADDRESS_HI
            bool "0x77 (SDO HIGH)"
    endchoice

    config BMX280_TIMEOUT
        int "Read/Write Timeout"
        default 50
        help
            Number of ticks to wait for I2C read/write operations.

    menu "Default Configuration"
        choice BMX280_DEFAULT_TEMPERATURE_OVERSAMPLING
            prompt "Temperature Oversampling"
            default BMX280_DEFAULT_TEMPERATURE_OVERSAMPLING_X2
            help
                Refer to BMP280/BME280 Datasheet for more information.
            config BMX280_DEFAULT_TEMPERATURE_OVERSAMPLING_NONE
                bool "None"
            config BMX280_DEFAULT_TEMPERATURE_OVERSAMPLING_X1
                bool "x1"
            config BMX280_DEFAULT_TEMPERATURE_OVERSAMPLING_X2
                bool "x2"
            config BMX280_DEFAULT_TEMPERATURE_OVERSAMPLING_X4
                bool "x4"
            config BMX280_DEFAULT_TEMPERATURE_OVERSAMPLING_X8
                bool "x8"
            config BMX280_DEFAULT_TEMPERATURE_OVERSAMPLING_X16
                bool "x16"
        endchoice

        choice BMX280_DEFAULT_PRESSURE_OVERSAMPLING
            prompt "Pressure Oversampling"
            default BMX280_DEFAULT_PRESSURE_OVERSAMPLING_X16
            help
                Refer to BMP280/BME280 Datasheet for more information.
            config BMX280_DEFAULT_PRESSURE_OVERSAMPLING_NONE
                bool "None"
            config BMX280_DEFAULT_PRESSURE_OVERSAMPLING_X1
                bool "x1"
            config BMX280_DEFAULT_PRESSURE_OVERSAMPLING_X2
                bool "x2"
            config BMX280_DEFAULT_PRESSURE_OVERSAMPLING_X4
                bool "x4"
            config BMX280_DEFAULT_PRESSURE_OVERSAMPLING_X8
                bool "x8"
            config BMX280_DEFAULT_PRESSURE_OVERSAMPLING_X16
                bool "x16"
        endchoice

        choice BMX280_DEFAULT_STANDBY
            prompt "Cyclic Measurement Standby Time"
            default BMX280_DEFAULT_STANDBY_0M5
            help
                Refer to BMP280/BME280 Datasheet for more information.
            config BMX280_DEFAULT_STANDBY_0M5
                bool "0.5ms"
            config BMX280_DEFAULT_STANDBY_62M5
                bool "62.5ms"
            config BMX280_DEFAULT_STANDBY_125M
                bool "125ms"
            config BMX280_DEFAULT_STANDBY_250M
                bool "250ms"
            config BMX280_DEFAULT_STANDBY_500M
                bool "500ms"
            config BMX280_DEFAULT_STANDBY_1000M
                bool "1000ms"
            config BMX280_DEFAULT_STANDBY_10M
                bool "BMP280: 2000ms // BME280: 10ms"
            config BMX280_DEFAULT_STANDBY_20M
                bool "BMP280: 4000ms // BME280: 20ms"
        endchoice

        choice BMX280_DEFAULT_IIR
            prompt "IIR Filter Sensitivity"
            default BMX280_DEFAULT_IIR_X16
            help
                Refer to BMP280/BME280 Datasheet for more information.
            config BMX280_DEFAULT_IIR_NONE
                bool "Filter Off"
            config BMX280_DEFAULT_IIR_X2
                bool "x2"
            config BMX280_DEFAULT_IIR_X4
                bool "x4"
            config BMX280_DEFAULT_IIR_X8
                bool "x8"
            config BMX280_DEFAULT_IIR_X16
                bool "x16"
        endchoice

        menu "BME280 Specific Options"
            depends on !(BMX280_EXPECT_BMP280)

            choice BMX280_DEFAULT_HUMIDITY_OVERSAMPLING
                prompt "Humidity Oversampling"
                default BMX280_DEFAULT_HUMIDITY_OVERSAMPLING_X1
                help
                    Refer to BME280 Datasheet for more information.
                config BMX280_DEFAULT_HUMIDITY_OVERSAMPLING_NONE
                    bool "None"
                config BMX280_DEFAULT_HUMIDITY_OVERSAMPLING_X1
                    bool "x1"
                config BMX280_DEFAULT_HUMIDITY_OVERSAMPLING_X2
                    bool "x2"
                config BMX280_DEFAULT_HUMIDITY_OVERSAMPLING_X4
                    bool "x4"
                config BMX280_DEFAULT_HUMIDITY_OVERSAMPLING_X8
                    bool "x8"
                config BMX280_DEFAULT_HUMIDITY_OVERSAMPLING_X16
                    bool "x16"
            endchoice
        endmenu
    endmenu
endmenu
```
